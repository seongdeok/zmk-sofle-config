## config/boards/shields/gaggs_kyria/Kconfig.defconfig
```kconfig
if SHIELD_GAGGS_KYRIA_LEFT || SHIELD_GAGGS_KYRIA_RIGHT

config ZMK_SPLIT
    default y
config ZMK_KEYBOARD_NAME
    default "GaggsKyria"
endif

if SHIELD_GAGGS_KYRIA_LEFT

config ZMK_SPLIT_ROLE_CENTRAL
    default y

endif
```

## config/boards/shields/gaggs_kyria/Kconfig.shield
```kconfig
config SHIELD_GAGGS_KYRIA_LEFT
    def_bool $(shields_list_contains,gaggs_kyria_left)

config SHIELD_GAGGS_KYRIA_RIGHT
    def_bool $(shields_list_contains,gaggs_kyria_right)
```
